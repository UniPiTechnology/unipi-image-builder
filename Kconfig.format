## Kconfig.format
```kconfig
#
# For a description of the syntax of this configuration file,
# see the file Documentation/kbuild/kconfig-language.txt in the
# Linux kernel source tree.
#
mainmenu "Unipi Image Builder Output Format"

#choice
#	prompt "Output image format"
#	default IMAGE_FORMAT_TAR

config IMAGE_FORMAT_TAR
	bool
	prompt "Chroot directory stored as tarball"
	default y

config IMAGE_FORMAT_VM
	bool "Image for virtual machine VM (single ext4 fs)"
	select IMAGE_FORMAT_TAR

config IMAGE_FORMAT_SWU
	bool "Image packed into SWupdate format"
	select IMAGE_FORMAT_TAR

config IMAGE_FORMAT_RAW
	bool "Raw disc image including partition table"
	select IMAGE_FORMAT_TAR

config IMAGE_FORMAT_RAWMINI
	bool "Raw disc image minimal - bootloader only"
	select IMAGE_FORMAT_TAR

config IMAGE_FORMAT_RAWPART
	bool "Raw partitions in files"
	select IMAGE_FORMAT_TAR

source "Kconfig.format.add"

#endchoice

config USE_VOLUMES
	bool
	default y if IMAGE_FORMAT_SWU
	default y if IMAGE_FORMAT_RAW
	default y if IMAGE_FORMAT_RAWMINI
	default y if IMAGE_FORMAT_RAWPART

source "volumes/Kconfig"

menu "SBOM (Software Bill of Materials)"

choice
	prompt "SBOM generator backend"
	default SBOM_BACKEND_NONE

config SBOM_BACKEND_NONE
	bool "Disabled (no SBOM)"

config SBOM_BACKEND_TRIVY
	bool "Trivy (aquasecurity)"
	help
	  Use Trivy to scan the extracted rootfs. Supports CycloneDX,
	  SPDX tag-value, SPDX JSON, GitHub dependency snapshot and a
	  human-readable vulnerability table. Requires the 'trivy'
	  binary on the host.

config SBOM_BACKEND_DEBSBOM
	bool "debsbom (Siemens, Debian-native)"
	help
	  Use debsbom to generate SBOMs from the dpkg status of the
	  built rootfs.

	  debsbom is just a glue layer; the actual serialization is
	  delegated to format libraries that must be present on the
	  host:
	    CycloneDX JSON -> python3-cyclonedx-lib   (in Debian trixie)
	    SPDX JSON      -> python3-spdx-tools      (NOT in trixie,
	                                               only in Debian sid
	                                               or via pip)

	  Install with:
	    apt install debsbom python3-cyclonedx-lib

endchoice

if SBOM_BACKEND_TRIVY

config SBOM_CYCLONEDX
	bool "CycloneDX (JSON)"
	default n
	help
	  Emit <image>.cdx.json in CycloneDX 1.x JSON format.

config SBOM_SPDX
	bool "SPDX (tag-value)"
	default n
	help
	  Emit <image>.spdx in SPDX tag-value format.

config SBOM_SPDX_JSON
	bool "SPDX (JSON)"
	default n
	help
	  Emit <image>.spdx.json in SPDX JSON format.

config SBOM_GITHUB
	bool "GitHub dependency snapshot (JSON)"
	default n
	help
	  Emit <image>.github.json in the GitHub dependency snapshot
	  format suitable for upload to the GitHub Dependency API.

config SBOM_TABLE
	bool "Vulnerability report (human-readable table)"
	default n
	help
	  Emit <image>.trivy.txt with a human-readable vulnerability
	  table produced by 'trivy rootfs' (no SBOM, scan only).

config SBOM_HASHES
	bool "Per-file SHA-256 hashes (TR-03183-2 §5.2.2)"
	default n
	help
	  Enrich the CycloneDX and SPDX SBOMs with the SHA-256 of every
	  installed file per component, read from the rootfs dpkg database
	  (Trivy does not emit component hashes). This is required by
	  BSI TR-03183-2 §5.2.2 ("hash value of the executable component").

	  CycloneDX: unipi:fileHash:sha256 properties.
	  SPDX 2.3: files[] with SHA-256 checksums + CONTAINS relationships
	  + filesAnalyzed/packageVerificationCode.

	  Note: significantly increases SBOM size (~13x for SPDX, ~13x for
	  CycloneDX) due to per-file granularity. Requires python3.

config SBOM_VEX
	bool "CIP kernel VEX (vulnerability exploitability exchange)"
	default n
	depends on SBOM_CYCLONEDX
	help
	  Emit a CycloneDX VEX (<image>.vex.json) for the unipi-kernel
	  component, derived from the CIP kernel security tracker
	  (cip-kernel-sec). Marks kernel CVEs already fixed (resolved) or
	  not-applicable (not_affected) on the CIP SLTS branch so consumers
	  (e.g. DependencyTrack) suppress them, leaving only genuinely open
	  kernel CVEs visible via the component's linux_kernel CPE.

	  Requires the YAML output of cip-kernel-sec's report_affected.py
	  for the target CIP branch, run with the exact built tag so the
	  classification matches the shipped kernel, e.g.:
	    report_affected.py --output-format yaml -o affected.yaml \
	        --branch cip/6.12:v6.12.94-cip26
	  Set SBOM_VEX_REPORT to that file's path (env or .config).
	  Requires python3 + PyYAML (python3-yaml).

config SBOM_VEX_REPORT
	string "report_affected.py --output-format yaml output path"
	depends on SBOM_VEX
	help
	  Filesystem path to the YAML produced by
	  `scripts/report_affected.py --output-format yaml -o <file>
	  --branch <cip-branch>:<tag>` from a cip-kernel-sec checkout.
	  CVEs in the `affected` bucket are treated as OPEN (not VEXed);
	  `fixed` -> resolved; `ignored` -> not_affected.

endif # SBOM_BACKEND_TRIVY

if SBOM_BACKEND_DEBSBOM

config SBOM_DEBSBOM_CYCLONEDX
	bool "CycloneDX (JSON)"
	default y
	help
	  Emit <image>.cdx.json in CycloneDX JSON format produced
	  by 'debsbom generate -t cdx'.

config SBOM_DEBSBOM_SPDX_JSON
	bool "SPDX (JSON)  [needs python3-spdx-tools, not in trixie]"
	default n
	help
	  Emit <image>.spdx.json in SPDX JSON format produced
	  by 'debsbom generate -t spdx'.

	  WARNING: requires python3-spdx-tools on the host, which
	  is currently NOT packaged for Debian trixie (only sid).
	  Either install it from sid, install via
	  'pip install --break-system-packages spdx-tools', or use
	  a Python venv. Without it the build will fail with
	  "Missing dependency: spdx-tools".

config SBOM_DEBSBOM_VALIDATE
	bool "Validate generated SPDX"
	depends on SBOM_DEBSBOM_SPDX_JSON
	default n
	help
	  Pass --validate to 'debsbom generate' (SPDX only).

config SBOM_DEBSBOM_WITH_LICENSES
	bool "Include license information"
	default y
	help
	  Pass --with-licenses to 'debsbom generate'. Parses the
	  copyright files of installed packages, which slows down
	  generation but produces a much richer SBOM.

endif # SBOM_BACKEND_DEBSBOM

config SBOM
	bool
	default y if SBOM_CYCLONEDX || SBOM_SPDX || SBOM_SPDX_JSON || SBOM_GITHUB || SBOM_TABLE
	default y if SBOM_DEBSBOM_CYCLONEDX || SBOM_DEBSBOM_SPDX_JSON

endmenu
```

## configs/edge-sbom_defconfig
```kconfig
CONFIG_UNIPI_SOURCE=y
CONFIG_EDGE=y
CONFIG_UNIPI_ALTBOOT=y
CONFIG_INSTALL_LTE=y
CONFIG_UNIPI_EVOK=y
CONFIG_SBOM=y
CONFIG_SBOM_BACKEND_TRIVY=y
CONFIG_SBOM_CYCLONEDX=y
```
