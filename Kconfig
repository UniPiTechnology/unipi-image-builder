## unipi/Kconfig
```kconfig
if UNIPI_SOURCE

choice
	prompt "Unipi platform selection"

config EDGE
	bool "Unipi Edge"
	select SOC_BCM

config NEURON
	bool "Unipi Neuron"
	select RPI_SOURCE
	select SOC_BCM

config PATRON
	bool "Unipi Patron"
	select SOC_IMX

config IRIS
	bool "Unipi Iris"
	select SOC_IMX

config GATE
	bool "Unipi Gate"
	select SOC_ROCK

config UNIPI1
	bool "Unipi Unipi1"
	select SOC_BCM

config ZULU
	bool "Unipi Zulu SBC"
	select SOC_IMX

config OEMZULU
	bool "OEM Zulu based platform"
	select SOC_IMX

endchoice

config PRODUCT
	string "Select OEM name" if OEMZULU
	default "edge" if EDGE
	default "neuron" if NEURON
	default "patron" if PATRON
	default "g1" if GATE
	default "iris" if IRIS
	default "unipi1" if UNIPI1
	default "zulu" if ZULU

config SOC_BCM
	bool
	depends on EDGE || NEURON || UNIPI1

config SOC_IMX
	bool
	depends on PATRON || IRIS || OEMZULU || ZULU

config SOC_ROCK
	bool
	depends on GATE

config UNIPI_32_BIT
	bool "Select 32-bit armhf architecture" if NEURON
	default n if EDGE || PATRON || GATE || IRIS

config PLATFORM_YAML
	string "Define yaml file with platform boot disc parameters"
	default "volumes/unipi_edge.yaml" if EDGE
	default "volumes/unipi_zulu.yaml" if SOC_IMX
	default "volumes/unipi_g1.yaml" if G1
	default "volumes/unipi_axon.yaml" if AXON


config UNIPI_ESSENTIAL
	bool "Install Unipi essential packages"
	default y if ! UNKNOWN
	help
	  Install Linux kernel an bootloader (U-boot, raspi-firmware)
	  This is required for boot image on real Unipi controller.

config UNIPI_ALTBOOT
	bool "Install Unipi altboot package"
	default y if OEMZULU || ZULU
	help
	  Install Unipi altboot package

config UNIPI_RECOMMENDED
	bool "Install Unipi specific recommended packages"
	default y if ! UNKNOWN && ! ZULU
	help
	  Install important packages to use all Unipi hardware component.
	    - unipi-kernel-modules for access to hw components
	    - os-configurator to self configure OS
	    - altboot to enable service boot mode
	    - unipi-modbus-tools (modbus server), mbpoll (modbus client)

config UNIPI_LOCALES
	bool "Set default locales"
	default y if ! UNKNOWN

config UNIPI_DEFAULT_PASSWORD
	bool "Install tool for setting default unipi password"
	default y if ! UNKNOWN

config UNIPI_REGENERATE_SSH
	bool "Install service to regenerate ssh server keys"
	default y if ! UNKNOWN

config UNIPI_RESIZE_PARTITION
	bool "Extend last partition to max free space during first boot"
	default y if ! UNKNOWN

config UNIPI_UPDATE_REGDB
	bool "Install upstream regulatory.db for wifi"
	default y if ! UNKNOWN

config UNIPI_WAIT_ONLINE
	bool "Systemd-wait-online wait for any interface not for all"
	default y if ! UNKNOWN

config UNIPI_DISABLE_JOURNAL
	bool "Disable persistent journal"
	default y if ! UNKNOWN

config UNIPI_IMAGE_VERSION
	bool
	default y if ! UNKNOWN

config UNIPI_TMP_IN_RAM
	bool "Mount /tmp into RAM"
	default y
	help
	  Mount tmpfs on directory /tmp. Max size of used RAM is 150MB

config UNIPI_GETTY
	bool "Enable getty only if framebuffer exists"
	default y

config UNIPI_FWUPDATE
	bool "Force firmware update on first boot" if ! GATE && ! UNIPI1
	default n

config UNIPI_EVOK
	bool "Install Evok server" if ! EDGE && ! GATE
	default n

config UNIPI_HAVEGED
	bool "Install haveged daemon"
	default n

config UNIPI_TPM2
	bool "Install TPM2 tools"
	default y if EDGE

endif
```

## volumes/Kconfig
```kconfig
choice
	prompt "Partition table and volumes" if IMAGE_FORMAT_SWU || IMAGE_FORMAT_RAW || IMAGE_FORMAT_RAWMINI
	default PARTITION_STD

config PARTITION_STD
	bool "Two ext4 partitions (root, boot)"
	help
	  Storage divided into two partitions. Small boot (200M)
	  and rest of space for system and data as root.
	  Both partitions formated as ext4

config PARTITION_SINGLE
	bool "Single partition only"
	help
	  Storage device contains single partition over the whole space.
	  If platform like CM40 requires FAT boot partiton, there will
	  be another boot partiton.

config PARTITION_DUAL
	bool "Dual boot ready (rootA, rootB, data)"
	help
	  Storage device divided into three partitions. RootA with system,
	  empty RootB prepared for future update of system, data for persistent
	  data. Size of RootA and RootB is 2,5GB each. The rest of storage space
	  is alocated for data

config PARTITION_BTR
	bool "One btrfs partitions with 4 subvolumes"
	help
	  Don't use on MMC storage due to more extensive write rate comparing
	  to ext4 fs

config PARTITION_USER
	bool "User defined partitions - file packaging/parts-user.yaml"
	help
	  Create your own definition of partition table an filesystem. 
	  Requires to create file packaging/parts-user.yaml

endchoice

config PARTITION_DEFAULT
	bool
	help
	  To be set by user packaging

config PARTITIONS_YAML
	string
	default "volumes/standard/parts-std.yaml" if PARTITION_STD
	default "volumes/single-part/parts-single.yaml" if PARTITION_SINGLE || PARTITION_DEFAULT
	default "volumes/ab-system/parts-dual.yaml" if PARTITION_DUAL
	default "volumes/btrfs/parts-btr.yaml" if PARTITION_BTR
	default "volumes/user/parts-user.yaml" if PARTITION_USER

if PARTITION_STD
config PARTITION_STD_BOOT_SIZE
	string "Size of boot partition"
	default "200M"
	help
	  Set size of boot partition. For example 150M or 1G.

config PARTITION_STD_ROOT_SIZE
	string "Size of root partition"
	default ""
	help
	  Set size of root partition in MB. If empty, partition will be 
	  extended to maximum free space of storage.
endif

if PARTITION_DUAL
config PARTITION_DUAL_ROOT_SIZE
	string "Size of root partition"
	default "2500M"
	help
	  Set size of both A and B root partitions. For example 2500M or 4G

config PARTITION_DUAL_DATA_SIZE
	string "Size of data partition"
	default ""
	help
	  Set size of data partition. If empty, partition will be 
	  extended to maximum free space of storage.
endif
```
