## Kconfig
```kconfig
#
# For a description of the syntax of this configuration file,
# see the file Documentation/kbuild/kconfig-language.txt in the
# Linux kernel source tree.
#
mainmenu "Unipi Image Builder Configuration"

choice
	prompt "Debian Suite"
	default DEBIAN_SUITE_STABLE

config DEBIAN_SUITE_OLDOLDSTABLE
	depends on !EDGE
	bool "Use Debian oldoldstable release (buster)"

config DEBIAN_SUITE_OLDSTABLE
	depends on !EDGE
	bool "Use Debian oldstable release (bullseye)"

config DEBIAN_SUITE_STABLE
	bool "Use Debian stable release (bookworm)"

config DEBIAN_SUITE_TESTING
	bool "Use Debian testing release (trixie)"

config DEBIAN_SUITE_OTHER
	bool "Use othe specified release"

endchoice

config DEBIAN_SUITE
	string
	prompt "Choose Debian release" if DEBIAN_SUITE_OTHER
	default "bullseye" if DEBIAN_SUITE_OLDSTABLE
	default "bookworm" if DEBIAN_SUITE_STABLE
	default "trixie" if DEBIAN_SUITE_TESTING
	help
	  Use some codename of Debian release which will  in apt source list.

choice
	prompt "Package selection"
	default VARIANT_APT
	help
	  All package sets also include the direct and indirect hard dependencies (but not recommends) of the selected package
	  sets. The variants minbase, buildd and -, resemble the package sets that debootstrap would install with the same
	  --variant argument. The release with a name matching the SUITE argument as well as the native architecture will be used
	  to determine the "Essential:yes" and priority values. To select packages with matching priority from any suite, specify
	  the empty string for SUITE. The default variant is debootstrap.

config VARIANT_EXTRACT
	bool "no Essential, extract only"
	help
	  Installs nothing by default (not even "Essential:yes" packages). Packages given by the "--include" option are
	  extracted but will not be installed.

config VARIANT_CUSTOM
	bool "no Essential"
	help
	  Installs nothing by default (not even "Essential:yes" packages). Packages given by the "--include" option will be
	  installed.  If another mode than chrootless was selected and dpkg was not part of the included package set, then
	  this variant will fail because it cannot configure the packages.

config VARIANT_ESSENTIAL
	bool "Essential"
	help
	  "Essential:yes" packages.

config VARIANT_APT
	bool "Essential + apt"
	help
	  The essential set plus apt. This variant uses the fact that apt treats itself as essential and thus running
	  "apt-get dist-upgrade" without any packages installed will install the essential set plus apt. If you just want
	  essential and apt, then this variant is faster than using the essential variant and adding apt via "--include"
	  because all packages get installed at once. The downside of this variant is, that if it should happen that an
	  essential package is not installable, then it will just get ignored without throwing an error.

config VARIANT_REQUIRED
	bool "Required, minbase"
	help
	  The essential set plus all packages with Priority:required and apt.  It is roughly equivalent to running
	  mmdebstrap with --variant=essential --include="?priority(required)"

config VARIANT_BUILDD
	bool "Minbase + building"
	help
	  The minbase set plus build-essential.  It is roughly equivalent to running mmdebstrap with
	  --variant=essential --include="?priority(required),build-essential"

config VARIANT_IMPORTANT
	bool "Important, debootstrap"
	help
	  The required set plus all packages with Priority:important. This is the default of debootstrap. It is roughly
	  equivalent to running mmdebstrap with
	  --variant=essential --include="~prequired|~pimportant"

config VARIANT_STANDARD
	bool "Standard"
	help
	  The important set plus all packages with Priority:standard.  It is roughly equivalent to running mmdebstrap with
	  --variant=essential --include="~prequired|~pimportant|~pstandard"

endchoice

config BUILD_VARIANT
	string
	default "extract" if VARIANT_EXTRACT
	default "custom" if VARIANT_CUSTOM
	default "essential" if VARIANT_ESSENTIAL
	default "apt" if VARIANT_APT
	default "required" if VARIANT_REQUIRED
	default "buildd" if VARIANT_BUILDD
	default "important" if VARIANT_IMPORTANT
	default "standard" if VARIANT_STANDARD

menuconfig UNIPI_SOURCE
	bool "Configure Unipi platform"
	help
	  Select Yes if image is for Unipi products.
	  This add Unipi repository to apt source list to enable install
	  Unipi specific packages like kernel, bootloader, devicetree ...

source "unipi/Kconfig"

config UNKNOWN
	bool 
	default ! UNIPI_SOURCE

config ARCHITECTURE
	string
	prompt "Select architecture"
	depends on UNKNOWN
	help
	  Write target architecture like arm64, armhf, amd64...


source "scripts/Kconfig"

menu "Addons"
source "Kconfig.addons"
endmenu

menu "Cleaning actions"

config EXCLUDE_MAN_PAGES
	bool "Remove man pages from installable files"
	default "y"

config CLEAN_APT_LIST
	bool "Remove the package lists and apt cache"
	default y
	help
	  After building the image remove downloaded package lists and clean
	  apt cache. User can download lists later using apt-get update.

config CLEAN_MACHINE_ID
	bool "Remove unreproducible identificator like machine-id"
	default y
	help
	  After building the image remove files that make the result 
	  unreproducible write the empty string to /etc/machine-id, remove
	  ssh server keys.

endmenu
```

## addons/nodered/Kconfig
```kconfig
config NODE_RED
	bool "Install Node-RED package"
	default n

config NODE_SOURCE
	bool
	default y if NODE_RED
	help
	  "Enable NodeJS Apt repositories"

config NODE_PROJECT
	bool "Create Node-RED default project for Unipi"
	depends on NODE_RED
	default y if NODE_RED
	help
	  "Install default project for Unipi controller"
```

## addons/vm/Kconfig
```kconfig
menu "Configure image for VM"

config IMAGE_SIZE
	int "Image size in MB"
	depends on IMAGE_FORMAT_EXT2 || IMAGE_FORMAT_EXT4
	default 0
	help
	  Resize final image to defined size in MB.

config NOPASSWD
	bool "Set empty password for user root"
	default n

source "addons/vm/autologin/Kconfig"

endmenu
```

## addons/vm/autologin/Kconfig
```kconfig
config AUTOLOGIN
	bool "Configure automatic root login"
	depends on ! INIT_NONE && ! INIT_BUSYBOX
	default n
	help
	  This is a mmdebstrap customize hook that configures automatic root login on a
	  serial console. It also parses the TERM kernel cmdline and passes it as
	  TERM to agetty. Since serial consoles do not transmit SIGWINCH, it causes
	  the shell to run setterm -resize on interactive, serial logins.
```

## configs/bookworm-acheating_defconfig
```kconfig
CONFIG_OEMZULU=y
CONFIG_PRODUCT="acheating"
CONFIG_UNIPI_FWUPDATE=y
CONFIG_INSTALL_WIFI=y
CONFIG_INSTALL_LTE=y
CONFIG_INSTALL_WIREGUARD=y
CONFIG_SUDO_USERNAME="acheating"
CONFIG_SUDO_PASSWD=y
CONFIG_SUDO_PASSWD_TEXT="|5|xQbIJbbHMVmbgThp|ecUPUI7QeBlqzzNQ55xIeymv7soGg4Rxz4RiTFUIDu6"
CONFIG_ACHEATING=y
CONFIG_IMAGE_FORMAT_SWU=y
CONFIG_PARTITION_DUAL=y
```

## configs/bookworm_edge_defconfig
```kconfig
CONFIG_PASSWD=y
CONFIG_PASSWD_FILE="rootpw"
CONFIG_ROOTKEY=y
CONFIG_ROOTKEY_FILE="sshkey"
CONFIG_IMAGE_SIZE=1024
```

## configs/edge-minimal_defconfig
```kconfig
CONFIG_UNIPI_SOURCE=y
CONFIG_EDGE=y
CONFIG_UNIPI_ALTBOOT=y
CONFIG_INSTALL_LTE=y
CONFIG_IMAGE_FORMAT_SWU=y
CONFIG_IMAGE_FORMAT_RAW=y
CONFIG_PARTITION_DEFAULT=y

CONFIG_SUDO_PASSWD=y
CONFIG_SUDO_PASSWD_TEXT="unipi"
```

## configs/patron-nodered_defconfig
```kconfig
CONFIG_UNIPI_SOURCE=y
CONFIG_PATRON=y
CONFIG_INSTALL_LTE=y
CONFIG_IMAGE_FORMAT_SWU=y
CONFIG_PARTITION_DEFAULT=y

CONFIG_SUDO_PASSWD=y
CONFIG_SUDO_PASSWD_TEXT="unipi"
CONFIG_UNIPI_EVOK=y
CONFIG_NODE_RED=y
```

## configs/trixie-zulu_defconfig
```kconfig
CONFIG_DEBIAN_SUITE_TESTING=y
CONFIG_ZULU=y
# CONFIG_UNIPI_DEFAULT_PASSWORD is not set
CONFIG_UNIPI_FWUPDATE=y
CONFIG_INSTALL_WIREGUARD=y
CONFIG_SUDO_KEY=y
CONFIG_SUDO_KEY_FILE="sshkey"
CONFIG_IMAGE_FORMAT_SWU=y
CONFIG_PARTITION_SINGLE=y
```

## configs/trixie_edge_defconfig
```kconfig
CONFIG_DEBIAN_SUITE_TESTING=y
CONFIG_INSTALL_LTE=y
CONFIG_INSTALL_WIREGUARD=y
CONFIG_SUDO_KEY=y
CONFIG_SUDO_KEY_FILE="sshkey"
CONFIG_MERVIS=y
# CONFIG_DISABLE_SSH is not set
CONFIG_IMAGE_FORMAT_SWU=y
CONFIG_IMAGE_FORMAT_RAW=y
CONFIG_PARTITION_SINGLE=y
```

## configs/trixie_patron_defconfig
```kconfig
CONFIG_DEBIAN_SUITE_TESTING=y
CONFIG_UNIPI_SOURCE=y
CONFIG_PATRON=y
CONFIG_UNIPI_ALTBOOT=y
CONFIG_INSTALL_LTE=y
CONFIG_INSTALL_WIREGUARD=y
CONFIG_IMAGE_FORMAT_SWU=y
CONFIG_IMAGE_FORMAT_RAW=y
CONFIG_PARTITION_SINGLE=y
```

## configs/zulu-minimal_defconfig
```kconfig
CONFIG_UNIPI_SOURCE=y
CONFIG_ZULU=y
CONFIG_INSTALL_LTE=y
CONFIG_IMAGE_FORMAT_SWU=y
CONFIG_PARTITION_DEFAULT=y

CONFIG_SUDO_PASSWD=y
CONFIG_SUDO_PASSWD_TEXT="unipi"
```

## scripts/Kconfig
```kconfig
source "scripts/init/Kconfig"

menu "Aditional packages"
source "scripts/packages/Kconfig"
endmenu

menu "Network settings"
source "scripts/network/Kconfig"
endmenu

menu "User settings"
source "scripts/users/Kconfig"
endmenu
```

## scripts/init/Kconfig
```kconfig
choice
	prompt "Init system"
	default INIT_SYSTEMD

config INIT_SYSTEMD
	bool "Systemd"
	help
	  The default. Required for Unipi packages like unipi-os-configurator etc.

config INIT_SYSV
	bool "System-V like init"

config INIT_RUNIT
	bool "Runit init system"

config INIT_BUSYBOX
	bool "Busybox only"
	help
	  For minimalistic images like initrd.

config INIT_NONE
	bool "No init system"
	help
	  The resulting image will not be bootable unless something else takes care of
	  creating /sbin/init

endchoice

config INIT_SYSTEM
	string
	default "systemd" if INIT_SYSTEMD
	default "sysv" if INIT_SYSV
	default "busybox" if INIT_BUSYBOX
	default "none" if INIT_NONE
```

## scripts/network/Kconfig
```kconfig
choice
	prompt "Networking system"
	default NETWORKD if INIT_SYSTEMD

config NETWORKD
	bool "systemd-networkd"
	help
	  Use systemd-networkd style for configuring networking.
	  No ifupdown/dhcpcd scripts

config IFUPDOWN
	bool "ifupdown"
	help
	  Use ifupdown style for configuring networking

endchoice

config NETWORK_NAMES
	bool "Use traditional network interface names"
	default y if ! UNKNOWN

config NETWORKD_IF
	bool "Configure interfaces"
	depends on NETWORKD
	default y if NETWORKD
	help
	  Set default configuration for interfaces.

config RESOLVED
	bool "Use systemd-resolved"
	default y if INIT_SYSTEMD
	depends on INIT_SYSTEMD
	help
	  Use systemd-resolved for dns resolving

source scripts/network/ifupdown/Kconfig

config INSTALL_WIFI
	bool "Install wifi support"
	default y if SOC_BCM
	help
	  Install packages needed for using wifi adapters

config INSTALL_LTE
	bool "Install LTE support"
	default n
	help
	  Install packages needed for using LTE adapters in Unipi controllers

config INSTALL_WIREGUARD
	bool "Install wireguard support"
	default n
	help
	  Install wireguard VPN support

config HOSTNAME
	string "Hostname"
	default "unipi"
	help
	  Set default hostname

config WAIT_ONLINE
	bool "Wait for any interface in systemd-wait-online not for all"
	default y if ! UNKNOWN
```

## scripts/network/ifupdown/Kconfig
```kconfig
config IFUPDOWN_IF
	bool "Use ifupdown suite for networking setup"
	depends on IFUPDOWN
	default n
```

## scripts/packages/Kconfig
```kconfig
config SYSTOOLS
	bool "System tools"
	default y
	help
	  Install procps, less, fdisk, cron, lsb-release, cpio, systemd-timesyncd, e2fsprogs

config NETTOOLS
	bool "Networking tools"
	default y
	help
	  Install iproute2, openssh-client, openssh-server, bridge-utils, iputils-ping, net-tools

config TOOLS
	bool "Usefull tools"
	default y
	help
	  Install python3-minimal, xxd, gpiod, busybox, usbutils, wget, curl

menu "Text editors"

config EDITOR_VIM
	bool "Vim editor"
	default y

config EDITOR_NANO
	bool "Nano editor"
	default y

config EDITOR_MC
	bool "Midnight Commander"
	default y

endmenu
```

## scripts/users/Kconfig
```kconfig
menu "Setup user root"

config ROOT_PASSWD
	bool "Set password for user root"
	depends on ! NOPASSWD
	default n

config ROOT_PASSWD_TEXT
	string "Password (encrypted) for user root"
	depends on ROOT_PASSWD
	default ""
	help
	  String contain password in open text or in encrypted form.
	  If password is open, it will be encrypted using SHA256 method 
	  and stored in the SAME variable.

config ROOT_KEY
	bool "Install authorized ssh key"
	help
	  Install public ssh key for root login via ssh

config ROOT_KEY_FILE
	string "Set authorized ssh key"
	depends on ROOT_KEY
	help
	  Source file with public ssh key

endmenu

menuconfig SUDO_USER
	bool "Add user with sudo privileges"
	default y

if SUDO_USER

config SUDO_USERNAME
	string "Name of the user"
	default "unipi"

config SUDO_PASSWD
	bool "Set password for user"
	default n

config SUDO_PASSWD_TEXT
	string "Password (encrypted) for user"
	depends on SUDO_PASSWD
	default ""
	help
	  String contain password in open text or in encrypted form.
	  If password is open, it will be encrypted using SHA256 method 
	  and stored in the SAME variable.

config SUDO_KEY
	bool "Install authorized ssh key"
	help
	  Install public ssh key for login via ssh

config SUDO_KEY_FILE
	string "File containing authorized ssh key"
	depends on SUDO_KEY
	help
	  Source file with public ssh key

endif
```
